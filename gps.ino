#include <SoftwareSerial.h>
#include <TinyGPS.h>
#include <Adafruit_GFX.h>
#include <Adafruit_PCD8544.h>
#include <EEPROM.h>
#include <math.h>

// Выводы дисплея
#define DISPLAY_CLK 4
#define DISPLAY_DIN 5
#define DISPLAY_DC  6
#define DISPLAY_CE  7
#define DISPLAY_RST 8
#define DISPLAY_LIGHT 9

// Пины софтового UART
#define SSERIAL_RX 2
#define SSERIAL_TX 3

// Контраст дисплея
#define DISPLAY_CONTRAST 55

// Кнопки
#define BUTTON_1 10
#define BUTTON_2 A5
#define BUTTON_3 A4

// Время яркой подсветки  в милисекундах
#define LIGHT_TIME 20*1000
// Время, в течение которого подсветка плавно угасает, в милисекундах
#define SOFT_LIGHT_TIME 100*1000

// Сглаживание резких изменений координат
#define SMOOTHING 5.0

// Адреса переменных в EEPROM
#define EEPROM_TARGET_ENABLED 0
#define EEPROM_TARGET 1
#define EEPROM_CURRENT_POINT_ADDRESS 9
#define EEPROM_POINTS_START 11  
#define EEPROM_POINTS_END EEPROM_POINTS_START+100*8

// Интервал записи точек трека в метрах
#define POINT_INTERVAL 50

// Расстояние, которое надо пройти, чтобы отобразилось направление
#define COURSE_DISTANCE 30

// Центральная точка дисплея
#define DISP_X0 42
#define DISP_Y0 24

// Текущий адрес, по которому будет сохраняться точка трекера
uint16_t eeprom_point_address = EEPROM_POINTS_START;

// Обект для работы с gps
TinyGPS gps;

//Tx, Rx
SoftwareSerial nss(SSERIAL_TX, SSERIAL_RX);

// Объект для работы с дисплеем
// CLK, DIN, DC, CE, RST
Adafruit_PCD8544 display = Adafruit_PCD8544(DISPLAY_CLK, DISPLAY_DIN, DISPLAY_DC, DISPLAY_CE, DISPLAY_RST);

// Последний момент включения подсветки в милисекундах
unsigned long lastLightTime = 0;

// Номер отображаемой в данный момент страницы
uint8_t currentPage = 0;

// Структура для хранения пар чисел
struct Coord
{
  float x = 0;
  float y = 0;
}

// Текущаая координата GPS - получаемая от навигатора, как только получается это сделать
current_point,
// Единичный вектор направления от предыдйщей точки GPS к текущей
current_ev,
// Координаты предыдущей точки GPS
prev_point,
// Единичный вектор направления к цели
target_ev,
// Координаты цели
target_point,
// Последняя точка, записанная в EEPROM
last_saved_point,
// Последняя точка, отображенная на карте
last_showed_point;



// Текущая скорость
float current_speed = 0,
      // Текущий азимут
      current_course = 0,
      // расстояние до цели
      target_distance = 0;

// Включена или выключена работа с целью
uint8_t target_enabled = false,
      page_switched = true;

static const unsigned char PROGMEM legend_thin_84x19[] = {
  0b00000000, 0b00000000, 0b00000000, 0b00000000, 0b00000000, 0b00000000, 0b00000000, 0b00000000, 0b00000000, 0b00000000, 0b00000000,
  0b00000000, 0b11000000, 0b00000000, 0b00000000, 0b00000000, 0b00000000, 0b00000000, 0b00000000, 0b00000000, 0b00000000, 0b00000000,
  0b00000001, 0b00000000, 0b00000000, 0b00000000, 0b00000000, 0b00000000, 0b00000000, 0b00000000, 0b00000000, 0b00000000, 0b00000000,
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  0b00000001, 0b01000000, 0b00000000, 0b00000000, 0b00000000, 0b00000000, 0b00000000, 0b00000000, 0b00000110, 0b11001001, 0b00010000
};

static const unsigned char PROGMEM legend_bold_84x19[] = {
  0b00000001, 0b11100000, 0b00000000, 0b00000000, 0b00000000, 0b00000000, 0b00000000, 0b00000000, 0b00000000, 0b00000000, 0b00000000,
  0b00000011, 0b11100000, 0b00000000, 0b00000000, 0b00000000, 0b00000000, 0b00000000, 0b00000000, 0b00000000, 0b00000000, 0b00000000,
  0b00000011, 0b11100000, 0b00000000, 0b00000000, 0b00000000, 0b00000000, 0b00000000, 0b00000000, 0b00000000, 0b00000000, 0b00000000,
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  0b00000011, 0b11110000, 0b00000000, 0b00000000, 0b00000000, 0b00000000, 0b00000000, 0b00000000, 0b00001111, 0b11111111, 0b11110000
};

static const unsigned char PROGMEM coords_75x8[] = {
  0b00100000, 0b00000000, 0b00000000, 0b00000000, 0b00000000, 0b00000000, 0b00000000, 0b00000000, 0b00000000, 0b00100000,
  0b10000110, 0b00110011, 0b10001110, 0b01001010, 0b01011100, 0b11101000, 0b10001010, 0b00110001, 0b11010010, 0b11100000,
  0b00010010, 0b10010100, 0b10010100, 0b10110100, 0b10000100, 0b10011001, 0b00010100, 0b10010010, 0b10101100, 0b11000000,
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  0b00000000, 0b10000000, 0b00000000, 0b00000000, 0b00000000, 0b00000000, 0b00000000, 0b00000000, 0b00010000, 0b00000000
};

static const unsigned char PROGMEM menu_84x48[] = {
0b00000000, 0b00000000, 0b00000000, 0b00000000, 0b00000000, 0b00000000, 0b00000000, 0b00000000, 0b00000000, 0b00000000, 0b00000000,
0b00000000, 0b00000000, 0b00000000, 0b00000000, 0b00000000, 0b00000000, 0b00000000, 0b00000000, 0b00000000, 0b00000000, 0b00000000,
0b00000000, 0b00000000, 0b00000000, 0b00000000, 0b00000000, 0b00000000, 0b00000000, 0b00000000, 0b00000000, 0b00000000, 0b00000000,
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0b00000000, 0b00000000, 0b00000000, 0b00000000, 0b00000000, 0b00000000, 0b00000000, 0b00000000, 0b00000000, 0b00000000, 0b00000000
};

static const unsigned char PROGMEM extremum84x48[] = {
0b00000000, 0b00000000, 0b00000000, 0b00000000, 0b00000000, 0b00000000, 0b00000000, 0b00000000, 0b00000000, 0b00000000, 0b00000000,
0b00000000, 0b00000000, 0b00000000, 0b00000000, 0b00000000, 0b00000000, 0b00000000, 0b00000000, 0b00000000, 0b00000000, 0b00000000,
0b00000000, 0b00000000, 0b00000000, 0b00000000, 0b00000000, 0b00000000, 0b00000000, 0b00000000, 0b00000000, 0b00000000, 0b00000000,
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0b00000000, 0b00000000, 0b00000000, 0b00000000, 0b00000000, 0b00000000, 0b00000000, 0b00000000, 0b00000000, 0b00000000, 0b00000000
};

static const unsigned char PROGMEM prikluchenzi84x48[] = {
0b00000000, 0b00000000, 0b00000000, 0b00000000, 0b00000000, 0b00000000, 0b00000000, 0b00000000, 0b00000000, 0b00000000, 0b00000000,
0b00000000, 0b00000000, 0b00000000, 0b00000000, 0b00000000, 0b00000000, 0b00000000, 0b00000000, 0b00000000, 0b00000000, 0b00000000,
0b00000000, 0b00000000, 0b00000000, 0b00000000, 0b00000000, 0b00000000, 0b00000000, 0b00000000, 0b00000000, 0b00000000, 0b00000000,
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0b00000000, 0b00000000, 0b00000000, 0b00000000, 0b00000000, 0b00000000, 0b00000000, 0b00000000, 0b00000000, 0b00000000, 0b00000000
};

static const unsigned char PROGMEM gran84x48[] = {
0b00000000, 0b00000011, 0b10000000, 0b00000000, 0b00000000, 0b00000000, 0b00000000, 0b00000000, 0b00000000, 0b00000000, 0b00000000,
0b00000000, 0b00001111, 0b11000000, 0b00000000, 0b00000000, 0b00000000, 0b00000000, 0b00000000, 0b00000000, 0b00000000, 0b00000000,
0b00000000, 0b00011111, 0b11100000, 0b00000000, 0b00000000, 0b00000000, 0b00000000, 0b00000000, 0b00000000, 0b00000000, 0b00000000,
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0b00000000, 0b00000000, 0b00000000, 0b00010000, 0b10000000, 0b00000000, 0b00000000, 0b00000000, 0b00000000, 0b00000000, 0b00000000
};

static const unsigned char PROGMEM presents68x7[] = {
0b11111011, 0b10011110, 0b01110001, 0b11011100, 0b10001110, 0b00111100, 0b11101001, 0b11001110, 0b00000000,
0b10001010, 0b01010000, 0b01010010, 0b00001001, 0b01001001, 0b00100101, 0b00101010, 0b00100100, 0b00000000,
0b10001010, 0b01011100, 0b01010010, 0b00001001, 0b01001110, 0b00100101, 0b00101110, 0b00100100, 0b00000000,
0b10001011, 0b10010000, 0b01010010, 0b00001001, 0b01001001, 0b00100101, 0b11101010, 0b00100100, 0b00000000,
0b10001010, 0b00010000, 0b10010010, 0b00001011, 0b11101001, 0b00100100, 0b10101010, 0b00100100, 0b00000000,
0b10001010, 0b00011111, 0b11111001, 0b11001010, 0b00101110, 0b01000101, 0b00101001, 0b11000101, 0b01010000,
0b00000000, 0b00000001, 0b00001000, 0b00000000, 0b00000000, 0b00000000, 0b00000000, 0b00000000, 0b00000000
};

static const unsigned char PROGMEM capitanskiy84x48[] = {
0b00000000, 0b00011101, 0b11000110, 0b00010001, 0b00010001, 0b11001000, 0b10111001, 0b00111001, 0b11001110, 0b00000000, 0b00000000,
0b00000000, 0b00100001, 0b00101000, 0b00010001, 0b00101001, 0b00101001, 0b10100010, 0b10010010, 0b00101001, 0b00000000, 0b00000000,
0b00000000, 0b00100001, 0b00101000, 0b00011111, 0b00101001, 0b11001010, 0b10100010, 0b10010010, 0b00101001, 0b00000000, 0b00000000,
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0b00000000, 0b00000001, 0b00000000, 0b00000000, 0b00000010, 0b00010000, 0b00000000, 0b00000000, 0b00100000, 0b00000000, 0b00000000
};

static const unsigned char PROGMEM search56x16[] = {
0b00000000, 0b00000111, 0b11001110, 0b01000100, 0b11101001, 0b00000000, 0b00000000,
0b00000000, 0b00000100, 0b01010001, 0b01001101, 0b00001010, 0b00000000, 0b00000000,
0b00000000, 0b00000100, 0b01010001, 0b01010101, 0b00001100, 0b00000000, 0b00000000,
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0b00000000, 0b00000000, 0b00000000, 0b00000000, 0b00000000, 0b00000000, 0b00000000
};

static const unsigned char PROGMEM owner_84x48[] = {           
0b00000000, 0b00000000, 0b00000000, 0b00000000, 0b00000000, 0b00000000, 0b00000000, 0b00000000, 0b00000000, 0b00000000, 0b00000000,
0b00000000, 0b00000000, 0b00000000, 0b00000001, 0b01000000, 0b00000000, 0b00000000, 0b00000000, 0b00000000, 0b00000000, 0b00000000,
0b01111100, 0b00000000, 0b00000000, 0b00000000, 0b10000000, 0b00000000, 0b00000000, 0b00000000, 0b00000000, 0b00000000, 0b00000000,
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0b00000000, 0b00000000, 0b00000000, 0b00000000, 0b00000000, 0b00000000, 0b00000000, 0b00000000, 0b00000000, 0b00000000, 0b00000000
};

// выводит на экран координаты в формате "град.мин.доли"
void displayCoordinates(float coord)
{
  int16_t full = (int)coord;
  float deg = (coord-full)*60*100/100;
  int16_t deg_full = (int)deg;
  int16_t def_discr = (int)((deg-(int)deg)*1000);
  if(full<10)
    display.print(0);
  if(full<100)
    display.print(0);
    
  display.print(full);
  display.print(" ");
  
  if(deg<10) 
    display.print(0);
    
  display.print((int)deg);
  display.print(".");
  
  if(def_discr<10)
    display.print(0);
  if(def_discr<100)
    display.print(0);
  
  display.print(def_discr);
  display.print("'");
}

// Возвращает расстояние между точками, заданными через широту и долготу
float coordToMeters(float lat1, float long1, float lat2, float long2)
{
  unsigned long rad = 6372795;
  float cl1, cl2, sl1, sl2, delta, cdelta, sdelta, x, y, ad;
  lat1 = lat1 * M_PI / 180;
  lat2 = lat2 * M_PI / 180;
  long1 = long1 * M_PI / 180;
  long2 = long2 * M_PI / 180;

  cl1 = cos(lat1);
  cl2 = cos(lat2);
  sl1 = sin(lat1);
  sl2 = sin(lat2);
  delta = long2 - long1;
  cdelta = cos(delta);
  sdelta = sin(delta);

  // вычисления длины большого круга
  y = sqrt(pow(cl2 * sdelta, 2) + pow(cl1 * sl2 - sl1 * cl2 * cdelta, 2));
  x = sl1 * sl2 + cl1 * cl2 * cdelta;
  ad = atan2(y, x);
  return ad * rad;
}
// Возвращает координаты одной GPS-точки относительно другой в метрах в прямоугольной
// системе координат
struct Coord pointMetersCoord(struct Coord basis, struct Coord point)
{
  struct Coord ev;
  ev.x = coordToMeters(basis.x, basis.y, point.x, basis.y);
  ev.y = coordToMeters(basis.x, basis.y, basis.x, point.y);
  if (point.x < basis.x)  ev.x = -ev.x;
  if (point.y < basis.y)  ev.y = -ev.y;
  return ev;
}

// Возвращает единичный вектор (в прямоуг. сист. коорд) для двух GPS-точек
struct Coord makeEV(struct Coord from, struct Coord to)
{
  struct Coord ev, inverted;
  ev = pointMetersCoord(from, to);
  float spows = sqrt(pow(ev.x, 2) + pow(ev.y, 2));
  ev.x = ev.x / spows;
  ev.y = ev.y / spows;
  inverted.x = -ev.y;
  inverted.y = -ev.x;
  return inverted;
  //return ev;
}

  /*
#define EEPROM_TARGET_ENABLE 0
#define EEPROM_TARGET 1
#define EEPROM_CURRENT_POINT_ADDRESS 9
#define EEPROM_POINTS_START 11  
#define EEPROM_POINTS_END EEPROM_POINTS_START+100*8
*/
void savePoint(struct Coord point)
{
  EEPROM.put(eeprom_point_address, point);
  eeprom_point_address += sizeof(struct Coord);
  if(eeprom_point_address >= EEPROM_POINTS_END) eeprom_point_address = EEPROM_POINTS_START;
  EEPROM.put(EEPROM_CURRENT_POINT_ADDRESS, eeprom_point_address);
  last_saved_point = point;
}
void loadCurrentPoint()
{
  EEPROM.get(EEPROM_CURRENT_POINT_ADDRESS, eeprom_point_address);
}

// Читает данные из GPS-приемника и записывает в глобальные переменные:
// prev_point
// current_point
// current_speed
// current_course
// target_ev
// target_distance - в километрах
// current_ev
void readGPSData()
{
  while (nss.available())
  {
    int gps_data = nss.read();
    if (gps.encode(gps_data))
    {
      unsigned long fix_age, last_distance;
      float x;
      struct Coord new_current_ev;
      //prev_point = current_point;
      gps.f_get_position(&(current_point.x), &(current_point.y), &fix_age);
      last_distance = coordToMeters(current_point.x, current_point.y, last_saved_point.x, last_saved_point.y);
      current_speed = current_speed + (gps.f_speed_kmph() - current_speed) / SMOOTHING;
      current_course = gps.f_course();
      if (target_enabled)
      {
        target_ev = makeEV(current_point, target_point);
        target_distance = coordToMeters(current_point.x, current_point.y, target_point.x, target_point.y)/1000;
      }

      if(current_point.x != 1000 && current_point.x != 1000 && current_point.x != 0 && current_point.x != 0)
      {
           
        // Вычисление единичного вектора направления движения
        if(last_distance > COURSE_DISTANCE)
        {
          new_current_ev = makeEV(prev_point, current_point);
          if(!(isnan(new_current_ev.x) || isnan(new_current_ev.y)
            || new_current_ev.x == 0 && new_current_ev.y == 0))
          {
            current_ev = new_current_ev;
            prev_point = current_point;
          }
        }
        
        // Сохранение точки
        if(last_distance > POINT_INTERVAL)
          savePoint(current_point);
      }
    }
  }

}


// Отображение логотипа-заставки
void drawLogo1()
{
  display.clearDisplay();
  display.drawBitmap(0, 0,  extremum84x48, 84, 48, 1);
  display.display();
  //return;
  delay(3000);
  display.clearDisplay();
    display.display();
  delay(500);
    display.drawBitmap(0, 0,  prikluchenzi84x48, 84, 48, 1);
  display.display();
  delay(3000);
  display.clearDisplay();
    display.display();
  delay(500);
    display.drawBitmap(0, 0,  gran84x48, 84, 48, 1);
  display.display();
  delay(3000);
  display.clearDisplay();
    display.display();
  delay(500);
  //  display.drawBitmap(8, 21,  presents68x7, 68, 7, 1);
  //display.display();
  //delay(3000);
  //display.clearDisplay();
  //display.display();
  //delay(500);
    display.drawBitmap(0, 0,  capitanskiy84x48, 84, 48, 1);
  display.display();
  delay(3000);
    display.clearDisplay();
  display.display();
  delay(500);
      display.drawBitmap(0, 0,  owner_84x48, 84, 48, 1);
  display.display();
  delay(5000);
    display.clearDisplay();
  display.display();
  delay(500);
    display.drawBitmap(15, 15,  search56x16, 55, 15, 1);
  display.display();
  
}

long pointX(float x)
{
  return (DISP_X0 - x);

}

long pointY(float y)
{
  return (DISP_Y0 + y);
}


// Отображение страницы с картой
void displayMap()
{
  if(current_point.x == 1000 && current_point.y == 1000
      || current_point.x == 0 && current_point.y == 0)
  {
    display.clearDisplay();
    display.drawBitmap(15, 15,  search56x16, 55, 15, 1);
    display.display();
  }
  // Чтение данных GPS 
  readGPSData();
  
  // Обновление страницы только если координата поменялась
  if(last_showed_point.x == current_point.x && last_showed_point.y == current_point.y
      && current_point.x != 1000 && current_point.y != 1000 && !page_switched)
    return;
  page_switched = false;
    
  /*if(coordToMeters(current_point.x, current_point.y, last_saved_point.x, last_saved_point.y)>POINT_INTERVAL)
    savePoint(current_point);*/
    
  display.clearDisplay();

  // Расстояние от центра до ближайшей стрелочки на цель
  uint8_t target_dist = 15,
       // Расстояние от центра до дальней стрелочки на цель
       target_dist2 = 18, 
      // половина ширины стрелок на цель
      target_pointer_width = 4,
      // половина ширины стрелки направления
      w = 3, 
      // длина стрелки направления
      h = 10;
      
  // треугольник - стрелка направления
  display.drawTriangle(pointX(current_ev.x * h), pointY(current_ev.y * h),
                       pointX(-current_ev.y * w), pointY(current_ev.x * w),
                       pointX(current_ev.y * w), pointY(-current_ev.x * w), BLACK);

  display.setTextSize(1);


  // отоюражение стрелок на цель и расстояния до нее  
  if(target_enabled)
  {
    int8_t target_ptrx, target_ptry, target_m_ptrx, target_m_ptry,
      target_ptrx2, target_ptry2, target_m_ptrx2, target_m_ptry2;
      
    target_ptrx = target_ev.x*target_dist;
    target_ptry = target_ev.y*target_dist;
    target_m_ptrx = target_ev.x*(target_dist-target_pointer_width);
    target_m_ptry = target_ev.y*(target_dist-target_pointer_width);
    
    target_ptrx2 = target_ev.x*target_dist2;
    target_ptry2 = target_ev.y*target_dist2;
    target_m_ptrx2 = target_ev.x*(target_dist2-target_pointer_width);
    target_m_ptry2 = target_ev.y*(target_dist2-target_pointer_width);
    
    display.drawLine(pointX(target_ptrx), pointY(target_ptry), 
      pointX(-target_ev.y*target_pointer_width+target_m_ptrx),
      pointY(target_ev.x*target_pointer_width+target_m_ptry), BLACK);
    display.drawLine(pointX(target_ptrx), pointY(target_ptry), 
      pointX(target_ev.y*target_pointer_width+target_m_ptrx),
      pointY(-target_ev.x*target_pointer_width+target_m_ptry), BLACK);
      
    display.drawLine(pointX(target_ptrx2), pointY(target_ptry2), 
      pointX(-target_ev.y*target_pointer_width+target_m_ptrx2),
      pointY(target_ev.x*target_pointer_width+target_m_ptry2), BLACK);
    display.drawLine(pointX(target_ptrx2), pointY(target_ptry2), 
      pointX(target_ev.y*target_pointer_width+target_m_ptrx2),
      pointY(-target_ev.x*target_pointer_width+target_m_ptry2), BLACK);
      
    display.setCursor(0, 0);
    display.print(target_distance, 2);
    display.print(" km");
  }
  

  // отображение трека из всей области трека в EEPROM
  struct Coord point, point_coords;
  float distance;
  for(uint16_t addr=EEPROM_POINTS_START; addr<EEPROM_POINTS_END; addr+=sizeof(struct Coord))
  {
    EEPROM.get(addr, point);
    if(point.x == 0) continue;
    point_coords.y = -
      coordToMeters(point.x, point.y, current_point.x, point.y);
    point_coords.x = -
      coordToMeters(point.x, point.y, point.x, current_point.y);
    
    if(current_point.x > point.x) point_coords.y = -point_coords.y;
    if(current_point.y > point.y) point_coords.x = -point_coords.x;
    point_coords.x = pointX(point_coords.x/25);
    point_coords.y = pointY(point_coords.y/25);
    if(point_coords.x>84 || point_coords.y>48) continue;
    display.drawPixel(point_coords.x, point_coords.y, BLACK);
  }
  
  //display.drawCircle(pointX(0), pointY(0), 2, BLACK);
  
  display.drawBitmap(0, 29,  legend_bold_84x19, 84, 19, 0);
  display.drawBitmap(0, 29,  legend_thin_84x19, 84, 19, 1);
  display.display();
  last_showed_point = current_point;
}

void displayMenu()
{
  int y = 11, s=8;
  int encoder0PinALast = LOW;
  int n = LOW;
  unsigned long lasttime = millis();
  
  while (true)
  {
    display.clearDisplay();

    display.drawBitmap(0, 0,  menu_84x48, 84, 48, 1);
    display.drawCircle(2, y, 2, BLACK);
    
    if(readButton(BUTTON_2)) 
    {
      y -= s;
    } 
    else if(readButton(BUTTON_3))
    {     
      y += s;
    }
    
    if(y < 11) y = 11+s*3;
    if(y > 11+s*3) y = 11;

    display.setTextSize(1);
    //display.setCursor(0, 0);
    //display.print("y");
    display.display();
    //break;
    if(readButton(BUTTON_1))
    {
      if(y == 11)
      {
        //return;
      }
      else if(y == 11+s)
      {
        editTarget();
      }
      else if(y == 11+s*2)
      {
        target_enabled = false;
      }
      else if(y == 11+s*3)
      {
        clearPoints();
      }
      nextPage();
      return;
    }
  }
}

void displaySetTargetWindow()
{
  display.clearDisplay();
  display.drawBitmap(5, 4, coords_75x8 , 75, 8, 1);
  display.display();
}

// Отображение страницы с данными GPS
void displayGPSdata()
{

  readGPSData();

  display.clearDisplay();
  display.setTextSize(1);
  display.setCursor(0, 0);


  display.print("N ");
  displayCoordinates(current_point.x);
  display.println();
  display.print("E ");
  displayCoordinates(current_point.y);
  display.println();
  display.print("Speed: ");
  display.print(current_speed, 0);
  display.println("km/h");
  display.print("Course: ");
  display.println(current_course, 0);
  display.print("Target: ");
  display.print(target_distance, 1);
  //display.print(sizeof(struct Coord));
  display.print("km");

  display.display();
}

// Отображает страницу редактирования цели
void editTarget()
{
  // grad
  // minute1 minute2
  // 1, 2, 3 - 
  uint8_t digit = 0, 
    estring = 0;
  
  struct Coord target = current_point;
    
  while(digit < 6 && estring <2)
  {
    display.clearDisplay();

    display.setCursor(0, 20);
    display.print("E ");
    displayCoordinates(target.x);

    display.setCursor(0, 30);
    display.print("N ");
    displayCoordinates(target.y);
    display.println();
    
    uint32_t x, y;
    float k;
    y = estring == 0? 22 : 32;
    
    if(digit == 0)
    {
      x = 6*2;
      k = 1;
    }
    else if(digit == 1)
    {
      x = 6*5+digit*6;
      k = 1.0/6;
    }
    else if(digit == 2)
    {
      x = 6*5+digit*6;
      k = 1.0/60;
    }
    else
    {
      x = 6*6+digit*6;
      if(digit == 3)
        k = 1.0/600;
      else if (digit == 4)
        k = 1.0/6000;
      else
        k = 1.0/60000;
    }
      
    
    if(readButton(BUTTON_2))
    {
      if(estring == 0)
        target.x += k;
      else
        target.y += k;
    }
    else if(readButton(BUTTON_3))
    {
      if(estring == 0)
        target.x -= k;
      else
        target.y -= k;
    }
    
    if(target.x < 0) target.x = 0;
    if(target.y < 0) target.y = 0;


    display.setCursor(0, 0);
    display.println("New target:");

    display.setCursor(x, y);
        
 
    if(digit == 0)
      display.print("___");
    else 
      display.print("_");
      
    display.display();
    // редактирование следующего разряда при нажатии кнопки
    if(readButton(BUTTON_1))
    {
      digit ++;
      if(digit == 6)
      {
        if(estring == 0)
        {
          estring = 1;
          digit = 0;
        }
        else 
        {
          target_point = target;
          target_enabled = true;
          saveTargetPoint();
          readGPSData();
          return;
        }
      }
    }
  }
  
}

// Устанавливает яркость в зависимости от давности последнего включения подсветки
void setLight()
{
  unsigned long time_delay;
  uint8_t light_level;

  time_delay = millis() - lastLightTime;
  if (time_delay < LIGHT_TIME)
    light_level = 0;
  else if (time_delay < SOFT_LIGHT_TIME)
    light_level = 255 - 255 / ((time_delay - LIGHT_TIME + 1) / 1000);
  else
    light_level = 255;

  analogWrite(DISPLAY_LIGHT, light_level);
}

// Включает подсветку дисплея
void lightUp()
{
  lastLightTime = millis();
  setLight();
}

// Возвращает 1, если подсветка дисплея еще включена
bool lightEnabled()
{
  return millis() - lastLightTime < LIGHT_TIME ? true : false;
}

// Проверяет нажатие кнопки с защитой от дребезга
// продолжает выполнение кода после отпускания кнопки
bool readButton(uint8_t button)
{
  if (digitalRead(button) == LOW)
  {
    delay(1);
    if (digitalRead(button) == LOW)
    {
      while (digitalRead(button) == LOW);
      return true;
    }
  }
  return false;
}

// Отображает нужную страницу по номеру
void showPage()
{
  if (currentPage == 0)
  {
    displayMap();
  }
  else if (currentPage == 1)
  {
    displayGPSdata();
  }
  
  else if(currentPage == 2)
  {
    displayMenu();
  }

  else
  {
    currentPage = 0;
    showPage();
  }
}

// Переключает отображение на следующую страницу
void nextPage()
{
  currentPage += 1;
  page_switched = true;
}

// Сохраняет точку цели
void saveTargetPoint()
{
  EEPROM.put(EEPROM_TARGET_ENABLED, (uint8_t)target_enabled);
  EEPROM.put(EEPROM_TARGET,target_point);
}

// Читает из EEPROM точку цели
void loadTargetPoint()
{
  EEPROM.get(EEPROM_TARGET_ENABLED, target_enabled);
  EEPROM.get(EEPROM_TARGET, target_point);
}

// Заливает ноликами все точки трека
void clearPoints()
{
  struct Coord empty;
  empty.x = 0;//59.9067;
  empty.y = 0;//30.2871;
  for(uint16_t addr=EEPROM_POINTS_START; addr<EEPROM_POINTS_END; addr+=sizeof(struct Coord))
  {
    EEPROM.put(addr, empty);
    //empty.x += 0.0001;
    //empty.y += 0.0001;
  }
}

void setup() {
  
  
  //target_point.x = 60.46913;
  //target_point.y = 30.15636;
  //target_enabled = true;
  //saveTargetPoint();
  
  clearPoints();
  
  //savePoint(current_point);
  loadTargetPoint();
  loadCurrentPoint();
  // put your setup code here, to run once:
  pinMode(BUTTON_1, INPUT_PULLUP);
  pinMode(BUTTON_2, INPUT_PULLUP);
  pinMode(BUTTON_3, INPUT_PULLUP);
  pinMode(DISPLAY_LIGHT, OUTPUT);
  pinMode(13, OUTPUT);

  digitalWrite(DISPLAY_LIGHT, LOW);

  // Инициализация дисплея
  // отображение заставки
  display.begin();
  display.setContrast(DISPLAY_CONTRAST);
  display.clearDisplay();
  display.display();
  drawLogo1();
  
  /*
  pinMode(A0, INPUT_PULLUP);
  pinMode(A1, INPUT_PULLUP);
  pinMode(A2, INPUT_PULLUP);
  pinMode(A3, INPUT_PULLUP);
  pinMode(A4, INPUT_PULLUP);
  pinMode(A5, INPUT_PULLUP);
  pinMode(A6, INPUT_PULLUP);
  pinMode(A7, INPUT_PULLUP);
  
  pinMode(0, INPUT_PULLUP);
  pinMode(1, INPUT_PULLUP);
  pinMode(10, INPUT_PULLUP);
  pinMode(11, INPUT_PULLUP);
  pinMode(12, INPUT_PULLUP);
  pinMode(13, INPUT_PULLUP);
  pinMode(14, INPUT_PULLUP);
  pinMode(15, INPUT_PULLUP);
  pinMode(17, INPUT_PULLUP);
  pinMode(18, INPUT_PULLUP);
  while(1)
  {
    display.clearDisplay();
    display.setCursor(0, 0);
    display.println(digitalRead(BUTTON));
    display.print(digitalRead(A0));
    display.print(digitalRead(A1));
    display.print(digitalRead(A2));
    display.print(digitalRead(A3));
    display.print(" ");
    display.print(digitalRead(A4));
    display.print(digitalRead(A5));
    display.print(digitalRead(A6));
    display.println(digitalRead(A7));
    display.print(digitalRead(0));
    display.print(digitalRead(1));
    display.print(digitalRead(10));
    display.print(digitalRead(11));
    display.print(" ");
    display.print(digitalRead(12));
    display.print(digitalRead(13));
    display.print(digitalRead(14));
    display.println(digitalRead(15));
    display.print(digitalRead(16));
    display.print(digitalRead(17));
    display.print(digitalRead(18));
    display.display();
  } 
  */
 
  nss.begin(9600);
  Serial.begin(9600);
}

unsigned long lastm = 0;
void loop() {

  // Регулирование подсветки - она должна угасать со временем
  setLight();

  // Отображение текущей страницы
  showPage();

  if (readButton(BUTTON_1))
  {
    if (lightEnabled())
      nextPage();
    else
      lightUp();
  }
}
